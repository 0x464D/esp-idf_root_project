## fma_components/fma_gpio/Kconfig.projbuild
```kconfig
menu "@FMA Component - GPIO"
    config USE_FMA_GPIO
        bool "Enable fma_gpio support"
        default n
endmenu
```

## fma_components/fma_lvgl/Kconfig.projbuild
```kconfig
menu "@FMA Component - LVGL"

config USE_FMA_LVGL
    bool "Enable fma_lvgl support"
    default n

choice
    prompt "Board Type"
    depends on USE_FMA_LVGL

config BOARD_LILYGO
    bool "LILYGO"

config BOARD_LILYGOS3
    bool "LILYGOS3"

config BOARD_LILYGOC3
    bool "LILYGOC3"

config BOARD_OTRA
    bool "OTRA"

endchoice

endmenu
```

## fma_components/fma_nimble_server/Kconfig.projbuild
```kconfig
menu "@FMA Component - BLE gatts server"

    # IMPORTANTE: Además de habilitar este componente (idf.py menuconfig), 
    # asegúrate de que 'Bluetooth' esté activado en el menú de configuración principal.
    # Bluetooth -> Bluetooth controller -> 'Enable Bluetooth controller'
    # Bluetooth -> Host -> 'NimBLE - BLE only'
    # Bluetooth -> Controller -> 'Enabled'
    config USE_FMA_NIMBLE_SERVER
        bool "Enable fma_nimble_server support"
        default n
endmenu
```
